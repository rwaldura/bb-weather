/*
 * This device tree enables the WL1835MOD cape on Beaglebone White (classic).
 * Additionally, it enables the operations implemented by Bonescript, e.g.
 * analogRead(), attachInterrupt(), etc. 
 *
 * Note, however, that the WL1835 cape grabs some pins for its own usage; 
 * those pins cannot be used for anything else. 
 * 
 ***
 * See also
 * https://octavosystems.com/app_notes/enabling-iot-with-osd335x/#_Toc382081444
 */
 
/dts-v1/;

#include "am33xx.dtsi"
#include "am335x-bone-common.dtsi"
#include "am335x-bone-common-univ.dtsi"

/ {
	model = "TI AM335x BeagleBone";
	compatible = "ti,am335x-bone", "ti,am33xx";

};

&sgx {
	status = "okay";
};

&ldo3_reg {
	regulator-min-microvolt = <1800000>;
	regulator-max-microvolt = <3300000>;
	regulator-always-on;
};

&mmc1 {
	vmmc-supply = <&ldo3_reg>;
};

#include "am335x-boneblack-wl1835mod-cape.dtsi"

